## src/modules/fa_pos_control/Kconfig
```kconfig
menuconfig MODULES_FA_POS_CONTROL
        bool "fa_pos_control"
        default n
        ---help---
                Enable support for fa_pos_control

menuconfig USER_FA_POS_CONTROL
        bool "fa_pos_control running as userspace module"
        default y
        depends on BOARD_PROTECTED
        ---help---
                Put fa_pos_control in userspace memory
```

## src/modules/se3_control/Kconfig
```kconfig
menuconfig MODULES_SE3_CONTROL
    bool "se3_control"
    default n
    ---help---
        Experimental native SE(3) position/attitude reference to PX4 rate loop.
```

## src/modules/trajectory_manager/Kconfig
```kconfig
menuconfig MODULES_TRAJECTORY_MANAGER
    bool "trajectory_manager"
    default n
    ---help---
        Start firmware-resident trajectory plans for PX4-native controllers.
```
